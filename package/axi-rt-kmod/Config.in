## package/axi-rt-kmod/Config.in
```kconfig
config BR2_PACKAGE_AXI_RT_KMOD
    bool "AXI RT config module"
    depends on BR2_LINUX_KERNEL
    help
      AXI RT kernel driver.
```

## package/memstresser/Config.in
```kconfig
config BR2_PACKAGE_MEMSTRESSER
       bool "memstresser"
       help
	Simple program for testing access to memory.
```
